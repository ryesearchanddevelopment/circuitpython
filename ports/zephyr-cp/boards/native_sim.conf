## ports/zephyr-cp/boards/native_sim.conf
```kconfig
CONFIG_EMUL=y
CONFIG_GPIO=y
CONFIG_NATIVE_SIM_SLOWDOWN_TO_REAL_TIME=n

# So we can test safe mode
CONFIG_NATIVE_SIM_REBOOT=y
```

## ports/zephyr-cp/zephyr-config/west.yml
```yaml
manifest:
  group-filter:
    - +babblesim
  projects:
    - name: nrf_hw_models
      url: https://github.com/tannewt/ext_nRF_hw_models
      revision: bb351cef9e5ab4d175fe3cb7c4d6761d837bac20
      path: modules/bsim_hw_models/nrf_hw_models
    - name: zephyr
      url: https://github.com/adafruit/zephyr
      revision: 8801b409ec554cfd217c159c00f91280ea1331db
      clone-depth: 100
      import: true
```
